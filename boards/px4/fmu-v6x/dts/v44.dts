/* Copyright (c) 2023 PX4 Development Team
 * SPDX-License-Identifier: BSD-3-Clause
 */

/dts-v1/;
#include "base.dtsi"
#include "spi1_icm20649.dtsi"
#include "spi3_icm20649.dtsi"

/ {
	version = "V44";
};
