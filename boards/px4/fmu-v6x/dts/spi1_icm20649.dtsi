/* Copyright (c) 2023 PX4 Development Team
 * SPDX-License-Identifier: BSD-3-Clause
 */

&spi1 {
	spi1_imu: icm20649@0 {
		status = "okay";
		compatible = "invensense,icm20649-px4";
		spi-max-frequency = <24000000>;
		reg = <0>;
		int-gpios = <&gpiof 2 GPIO_ACTIVE_HIGH>;
		supply-gpios = <&gpioi 11 GPIO_ACTIVE_HIGH>;
	};
};
