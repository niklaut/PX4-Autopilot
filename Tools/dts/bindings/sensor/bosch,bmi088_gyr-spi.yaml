## Tools/dts/bindings/sensor/bosch,bmi088_gyr-spi.yaml
```yaml
# Copyright (c) 2021, Bosch Sensortec GmbH
# Copyright (c) 2022, Nordic Semiconductor ASA
# SPDX-License-Identifier: Apache-2.0

description: |
    The BMI088 is an inertial measurement unit. See more info at:
    https://www.bosch-sensortec.com/products/motion-sensors/imus/bmi088.html
    This describes the gyroscope interface inside the BMI088.

include: ["sensor-device.yaml", "spi-device.yaml"]

compatible: "bosch,bmi088_gyr-px4"

properties:
  int-gpios:
    type: phandle-array
    description: INT pin

      This pin defaults to active high when produced by the sensor.
      The property value should ensure the flags properly describe
      the signal that is presented to the driver.
```

## Tools/dts/bindings/sensor/invensense,icm42688.yaml
```yaml
# Copyright (c) 2023 PX4 Development Team
# SPDX-License-Identifier: Apache-2.0

description: ICM-42688 motion tracking device

compatible: "invensense,icm42688-px4"

include: [sensor-device.yaml, spi-device.yaml]

properties:
  int-gpios:
    type: phandle-array
    description: |
      The INT signal default configuration is active-high. The
      property value should ensure the flags properly describe the
      signal that is presented to the driver.
```

## Tools/dts/bindings/sensor/px4,fmu-v6x.yaml
```yaml
# Copyright (c) 2023 PX4 Development Team
# SPDX-License-Identifier: Apache-2.0

description: Generic SPI Flash

compatible: "px4,fmu-v6x"

properties:
  version:
    type: string
    description: Hardware version
```

## Tools/dts/bindings/sensor/spi_flash.yaml
```yaml
# Copyright (c) 2023 PX4 Development Team
# SPDX-License-Identifier: Apache-2.0

description: Generic SPI Flash

compatible: "spi_flash-px4"

include: [spi-device.yaml]
```
